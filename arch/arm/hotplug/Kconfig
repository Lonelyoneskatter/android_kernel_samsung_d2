## arch/arm/hotplug/Kconfig
```kconfig
config ALUCARD_HOTPLUG
	bool "Enable alucard-hotplug cpu hotplug driver"
	default y
	help
	  Generic Alucard-hotplug cpu hotplug driver for ARM SOCs

config ASMP
        bool "Multi-core automatic hotplug support"
        depends on SMP && HOTPLUG_CPU
        default n
        help
          Automatically hotplugs the multiple cpu cores on and off
          based on cpu load and suspend state

config BLU_PLUG
	bool "Dynamic hotplug driver"
	depends on HOTPLUG_CPU
	default n
	help
	  The Dynamic hotplug driver automatically online/offline CPUs proportional to system load.

config BRICKED_HOTPLUG
	bool "Enable kernel based mpdecision"
	depends on MSM_RUN_QUEUE_STATS
	default y
	help
	  This enables kernel based multi core control.
	  (up/down hotplug based on load)

config DYNAMIC_HOTPLUG
	bool "Enable dynamic-hotplug cpu hotplug driver"
	default y
	help
	  Generic Dynamic-hotplug cpu hotplug driver for ARM SOCs

config INTELLI_PLUG
	bool "Enable intelli-plug cpu hotplug driver"
	default n
	help
	  Generic Intelli-plug cpu hotplug driver for ARM SOCs

config LAZYPLUG
	bool "Conservative hotplugging for generic devices"
	default n
	help
	  This enables the conservative hotplugging, lazyplug by arter97
	  based on intelli_plug. Refer to the comments for more info.

config MSM_HOTPLUG
	bool "MSM hotplug driver"
	depends on HOTPLUG_CPU
	default y
	help
	  The MSM hotplug driver controls on-/offlining of additional cores based
	  on current cpu load.

config MSM_SLEEPER
	bool "CPU hotplug driver"
 	default y
 	help
	  CPU hotplug driver controls on-/offlining of additional cores based
	  on suspend/resume.

config STATE_HELPER
        bool "State Helper"
	depends on STATE_NOTIFIER

config STATE_NOTIFIER
        bool "State Notifier"

config THUNDER_PLUG
      bool "Enable plugging down/up of cores using powersuspend"
      help
       This driver uses powersuspend to take down the cpu cores
       on a octa core device. Tuned to work on a dual core device.

config ZEN_DECISION
	bool "Zen Decision MPDecision Replacement"
	depends on SMP && FB
	default y
	help
	  MPDecision is a userspace service that does several functions
	  related to CPU Frequency and CPU Hotplugging. Some of these are:
	  - Remove cores when screen goes off
	  - Enable cores when screen goes on
	  - Raise CPU_MIN_FREQ to a fixed value for a few seconds on input
  
	  Zen Decision allows some of the MPDecison functions to be delegated
	  to the kernel. Right now these are
	  - Remove cores when screen goes off (after a configurable amount of time)
	  - Enable cores when screen comes on (immediately)

	  Zen Decision assumes the input boost function of MPDecision should be
	  delegated to somewhere else in the kernel (Such as in CPU-BOOST)

	  Enable this if you'd like the ability to disable MPDecision.
```
